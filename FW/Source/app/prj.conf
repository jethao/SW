## CMakeLists.txt
```
cmake_minimum_required(VERSION 3.20.0)

find_package(Zephyr REQUIRED HINTS $ENV{ZEPHYR_BASE})
project(airhealth_fw_app LANGUAGES C CXX)

target_sources(app PRIVATE
  src/main.cpp
  src/device_info_service.cpp
  ../src/pairing.cpp
  ../src/led_button.cpp
)

target_include_directories(app PRIVATE
  ../include
  src
)

target_compile_features(app PRIVATE cxx_std_17)
```

## prj.conf
```kconfig
CONFIG_GPIO=y
CONFIG_BT=y
CONFIG_BT_PERIPHERAL=y
CONFIG_BT_DEVICE_NAME="AirHealth"
CONFIG_BT_DEVICE_APPEARANCE=0
CONFIG_BT_MAX_CONN=1
CONFIG_LOG=y
CONFIG_LOG_MODE_IMMEDIATE=y
CONFIG_CONSOLE=y
CONFIG_SERIAL=y
CONFIG_UART_CONSOLE=y
CONFIG_NEWLIB_LIBC=y
CONFIG_NEWLIB_LIBC_NANO=n
CONFIG_CPP=y
CONFIG_STD_CPP17=y
CONFIG_REQUIRES_FULL_LIBCPP=y
CONFIG_CPP_EXCEPTIONS=y
CONFIG_HEAP_MEM_POOL_SIZE=16384
CONFIG_MAIN_STACK_SIZE=4096
```

## boards/nrf5340dk_nrf5340_cpuapp.conf
```kconfig
CONFIG_BT_DEVICE_NAME="AirHealth DK"
```

## boards/nrf5340dk_nrf5340_cpuapp.overlay
```dts
/ {
	aliases {
		airhealth-status-led = &led0;
		airhealth-action-button = &button0;
	};
};
```

## src/main.cpp
```c
#include "device_info_service.hpp"

#include "airhealth/fw/led_button.hpp"
#include "airhealth/fw/pairing.hpp"

#include <zephyr/bluetooth/bluetooth.h>
#include <zephyr/drivers/gpio.h>
#include <zephyr/kernel.h>
#include <zephyr/logging/log.h>

LOG_MODULE_REGISTER(airhealth_fw_app, LOG_LEVEL_INF);

namespace {

using airhealth::fw::ButtonHoldController;
using airhealth::fw::ButtonIntent;
using airhealth::fw::ButtonSample;
using airhealth::fw::ConsumerCapabilities;
using airhealth::fw::LedColor;
using airhealth::fw::LedController;
using airhealth::fw::RuntimeVisualState;

const gpio_dt_spec kStatusLed =
    GPIO_DT_SPEC_GET(DT_ALIAS(airhealth_status_led), gpios);
const gpio_dt_spec kActionButton =
    GPIO_DT_SPEC_GET(DT_ALIAS(airhealth_action_button), gpios);

bool configure_gpio(const gpio_dt_spec& spec, gpio_flags_t extra_flags) {
  if (!gpio_is_ready_dt(&spec)) {
    LOG_ERR("GPIO controller not ready for pin %d", spec.pin);
    return false;
  }

  const int rc = gpio_pin_configure_dt(&spec, extra_flags);
  if (rc != 0) {
    LOG_ERR("Failed to configure pin %d (%d)", spec.pin, rc);
    return false;
  }

  return true;
}

void apply_led_output(const airhealth::fw::LedOutput& output) {
  const int value = output.color == LedColor::Off ? 0 : 1;
  const int rc = gpio_pin_set_dt(&kStatusLed, value);
  if (rc != 0) {
    LOG_ERR("Failed to set status LED (%d)", rc);
  }
}

}  // namespace

int main() {
  if (!configure_gpio(kStatusLed, GPIO_OUTPUT_INACTIVE)) {
    return -1;
  }
  if (!configure_gpio(kActionButton, GPIO_INPUT)) {
    return -1;
  }

  const int bt_rc = bt_enable(nullptr);
  if (bt_rc != 0) {
    LOG_ERR("Bluetooth init failed (%d)", bt_rc);
    return bt_rc;
  }

  const auto device_info = airhealth::fw::make_device_info(
      "nrf5340dk_nrf5340_cpuapp",
      false,
      ConsumerCapabilities {
          .claim_required = true,
          .session_resume_supported = true,
          .power_state_reporting_supported = true,
      }
  );

  const int service_rc =
      airhealth::fw::app::init_device_info_service(device_info);
  if (service_rc != 0) {
    return service_rc;
  }

  const int advertise_rc = airhealth::fw::app::start_device_info_advertising();
  if (advertise_rc != 0) {
    return advertise_rc;
  }

  LedController led_controller;
  apply_led_output(led_controller.render(RuntimeVisualState::Ready));

  ButtonHoldController hold_controller;
  int held_ms = 0;

  LOG_INF("AirHealth firmware app booted");

  while (true) {
    const bool pressed = gpio_pin_get_dt(&kActionButton) > 0;
    held_ms = pressed ? held_ms + 100 : 0;

    const ButtonIntent intent = hold_controller.evaluate(ButtonSample {
        .pressed = pressed,
        .held_ms = held_ms,
        .factory_mode_active = false,
    });

    if (intent != ButtonIntent::None) {
      LOG_INF("Button intent: %s", airhealth::fw::button_intent_to_string(intent).c_str());
    }

    k_sleep(K_MSEC(100));
  }

  return 0;
}
```

## src/device_info_service.cpp
```c
#include "device_info_service.hpp"

#include <cstdint>

#include <zephyr/bluetooth/bluetooth.h>
#include <zephyr/bluetooth/gatt.h>
#include <zephyr/bluetooth/uuid.h>
#include <zephyr/logging/log.h>
#include <zephyr/sys/util.h>

LOG_MODULE_REGISTER(airhealth_device_info_service, LOG_LEVEL_INF);

namespace airhealth::fw::app {

namespace {

bt_uuid_128 kServiceUuid =
    BT_UUID_INIT_128(BT_UUID_128_ENCODE(0x6e400001, 0xb5a3, 0xf393, 0xe0a9, 0xe50e24dcca9e));
bt_uuid_128 kDeviceInfoUuid =
    BT_UUID_INIT_128(BT_UUID_128_ENCODE(0x6e400002, 0xb5a3, 0xf393, 0xe0a9, 0xe50e24dcca9e));

std::string g_device_info_payload;

ssize_t read_device_info(
    struct bt_conn* conn,
    const struct bt_gatt_attr* attr,
    void* buf,
    std::uint16_t len,
    std::uint16_t offset
) {
  ARG_UNUSED(conn);
  ARG_UNUSED(attr);
  return bt_gatt_attr_read(
      conn,
      attr,
      buf,
      len,
      offset,
      g_device_info_payload.data(),
      g_device_info_payload.size()
  );
}

BT_GATT_SERVICE_DEFINE(
    airhealth_gatt_service,
    BT_GATT_PRIMARY_SERVICE(&kServiceUuid.uuid),
    BT_GATT_CHARACTERISTIC(
        &kDeviceInfoUuid.uuid,
        BT_GATT_CHRC_READ,
        BT_GATT_PERM_READ,
        read_device_info,
        nullptr,
        nullptr
    )
);

const bt_data kAdvertisingData[] = {
    BT_DATA_BYTES(BT_DATA_FLAGS, BT_LE_AD_GENERAL | BT_LE_AD_NO_BREDR),
    BT_DATA(BT_DATA_NAME_COMPLETE, CONFIG_BT_DEVICE_NAME, sizeof(CONFIG_BT_DEVICE_NAME) - 1),
};

const bt_data kScanResponseData[] = {
    BT_DATA(BT_DATA_UUID128_ALL, kServiceUuid.val, sizeof(kServiceUuid.val)),
};

}  // namespace

int init_device_info_service(const DeviceInfo& device_info) {
  g_device_info_payload = "{"
                          "\"ok\":true,"
                          "\"method\":\"device.info.get\","
                          "\"result\":" +
      device_info_to_payload_json(device_info) + "}";
  LOG_INF(
      "Prepared device.info payload (%u bytes)",
      static_cast<unsigned int>(g_device_info_payload.size())
  );
  return 0;
}

int start_device_info_advertising() {
  const int rc = bt_le_adv_start(
      BT_LE_ADV_CONN_FAST_1,
      kAdvertisingData,
      ARRAY_SIZE(kAdvertisingData),
      kScanResponseData,
      ARRAY_SIZE(kScanResponseData)
  );
  if (rc != 0) {
    LOG_ERR("Failed to start BLE advertising (%d)", rc);
    return rc;
  }

  LOG_INF("BLE advertising started");
  return 0;
}

const std::string& device_info_payload() {
  return g_device_info_payload;
}

}  // namespace airhealth::fw::app
```

## src/device_info_service.hpp
```c
#pragma once

#include "airhealth/fw/pairing.hpp"

#include <string>

namespace airhealth::fw::app {

int init_device_info_service(const DeviceInfo& device_info);
int start_device_info_advertising();
const std::string& device_info_payload();

}  // namespace airhealth::fw::app
```
